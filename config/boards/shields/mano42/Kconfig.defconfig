## config/boards/shields/mano42/Kconfig.defconfig
```kconfig
# Copyright (c) 2022 The ZMK Contributors
# SPDX-License-Identifier: MIT

if SHIELD_MANO42_LEFT

config ZMK_KEYBOARD_NAME
	default "Mano42"

config ZMK_SPLIT_ROLE_CENTRAL
	default y
	
endif

if SHIELD_MANO42_LEFT || SHIELD_MANO42_RIGHT

config ZMK_SPLIT
	default y

endif
```

## config/boards/shields/mano42/Kconfig.shield
```kconfig
# Copyright (c) 2022 The ZMK Contributors
# SPDX-License-Identifier: MIT

config SHIELD_MANO42_LEFT
	def_bool $(shields_list_contains,mano42_left)

config SHIELD_MANO42_RIGHT
	def_bool $(shields_list_contains,mano42_right)
```
